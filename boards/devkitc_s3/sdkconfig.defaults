## boards/devkitc_s3/sdkconfig.defaults
```kconfig
# ESP32-S3-DevKitC-1-N16R8 board profile.
# 16 MB QIO flash + 8 MB octal PSRAM, WS2812 RGB on GPIO 48.
# Pair with: idf.py -D BOARD=devkitc_s3 set-target esp32s3

CONFIG_ESPTOOLPY_FLASHSIZE_16MB=y
CONFIG_ESPTOOLPY_FLASHSIZE="16MB"

CONFIG_PARTITION_TABLE_CUSTOM=y
CONFIG_PARTITION_TABLE_CUSTOM_FILENAME="boards/devkitc_s3/partitions.csv"

CONFIG_SPIRAM=y
CONFIG_SPIRAM_MODE_OCT=y
CONFIG_SPIRAM_SPEED_80M=y

# Bluetooth controller + NimBLE host compiled in but unused -- leaves
# the door open for the future BLE bridge source without a kernel
# reshuffle. The S2 doesn't have a BT radio so its profile omits this.
CONFIG_BT_ENABLED=y
CONFIG_BT_NIMBLE_ENABLED=y
```

## boards/lolin_s2_mini/sdkconfig.defaults
```kconfig
# Wemos LOLIN S2 Mini board profile.
# ESP32-S2FH4: 4 MB embedded flash, no PSRAM, no BT radio,
# plain LED on GPIO 15.
# Pair with: idf.py -D BOARD=lolin_s2_mini set-target esp32s2

CONFIG_ESPTOOLPY_FLASHSIZE_4MB=y
CONFIG_ESPTOOLPY_FLASHSIZE="4MB"

CONFIG_PARTITION_TABLE_CUSTOM=y
CONFIG_PARTITION_TABLE_CUSTOM_FILENAME="boards/lolin_s2_mini/partitions.csv"

# S2FH4 has no PSRAM and the S2 has no BT radio at all -- both
# Kconfig paths stay at their default "off" so nothing to set here.
```

## sdkconfig.defaults
```kconfig
# Truly target-agnostic defaults. Per-board overlays in
# boards/<name>/sdkconfig.defaults set flash size, partition table,
# PSRAM, and Bluetooth toggles. Switch boards via:
#     idf.py -D BOARD=<name> set-target <s2|s3>

CONFIG_LOG_DEFAULT_LEVEL_INFO=y
CONFIG_COMPILER_OPTIMIZATION_SIZE=y

# OTA -- bootloader rollback. After OTA, the new image boots in
# PENDING_VERIFY state; the firmware must call
# esp_ota_mark_app_valid_cancel_rollback() once it has reached a
# known-good state (Wi-Fi up + HTTP serving). If it crashes or
# reboots before that confirmation, the bootloader rolls back to the
# previous slot. CHECK_APP_HASH adds a SHA256 verify on each boot.
CONFIG_BOOTLOADER_APP_ROLLBACK_ENABLE=y
CONFIG_BOOTLOADER_WDT_ENABLE=y
```

## sdkconfig.defaults.esp32s3
```kconfig
# ESP32-S3 specific overlay.
#
# Tuned for ESP32-S3-DevKitC-1-N16R8: 16 MB QIO flash + 8 MB octal PSRAM.
# A different S3 board (e.g. N8R2 with 8 MB flash + 2 MB quad PSRAM) needs
# these flash/SPIRAM lines overridden - revisit during the S3-vs-S2
# final-target decision.
CONFIG_ESPTOOLPY_FLASHSIZE_16MB=y
CONFIG_ESPTOOLPY_FLASHSIZE="16MB"

CONFIG_SPIRAM=y
CONFIG_SPIRAM_MODE_OCT=y
CONFIG_SPIRAM_SPEED_80M=y

# Bluetooth controller + NimBLE host compiled in but unused - leaves the
# door open for the future BLE bridge source without a kernel reshuffle.
# (The S2 variant has no BT radio so this section doesn't apply there.)
CONFIG_BT_ENABLED=y
CONFIG_BT_NIMBLE_ENABLED=y
```
